## lab05/main/Kconfig.projbuild
```kconfig
menu "Example Configuration"

config GPIO_OUTPUT_0
    int "GPIO output pin #0"
    default 18
    help
        Set the GPIO pin for Pin #0

config GPIO_OUTPUT_1
    int "GPIO output pin #1"
    default 19
    help
        Set the GPIO pin for Pin #1

config GPIO_INPUT_0
    int "GPIO input pin #0"
    default 16
    help
        Set the GPIO pin for Pin #0

config GPIO_INPUT_1
    int "GPIO input pin #1"
    default 17
    help
        Set the GPIO pin for Pin #1

config GPIO_INPUT_2
    int "GPIO input pin #2"
    default 5
    help
        Set the GPIO pin for Pin #2


endmenu
```

## lab05END/main/Kconfig.projbuild
```kconfig
menu "Example Configuration"

config GPIO_OUTPUT_0
    int "GPIO output pin #0"
    default 18
    help
        Set the GPIO pin for Pin #0

config GPIO_OUTPUT_1
    int "GPIO output pin #1"
    default 19
    help
        Set the GPIO pin for Pin #1

config GPIO_INPUT_0
    int "GPIO input pin #0"
    default 16
    help
        Set the GPIO pin for Pin #0

endmenu
```
